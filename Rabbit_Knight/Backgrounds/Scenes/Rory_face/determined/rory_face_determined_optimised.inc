; RORY_FACE_DETERMINED_OPTIMISED.INC
;
; Map Include File.
;
; Info:
;   Section       : rory face det map
;   Bank          : 0
;   Map size      : 20 x 18
;   Tile set      : C:\Users\Jelli\OneDrive\Desktop\Rabbit_Knight\Tiles\Story-tiles\rory_face_determined_tileset_optimised.gbr
;   Plane count   : 1 plane (8 bits)
;   Plane order   : Tiles are continues
;   Tile offset   : 46
;   Split data    : No
;
; This file was generated by GBMB v1.8

rory_face_determinedWidth  EQU 20
rory_face_determinedHeight EQU 18
rory_face_determinedBank   EQU 0

 GLOBAL rory_face_determined

; End of RORY_FACE_DETERMINED_OPTIMISED.INC
