; RORY_FACE_BLINK_TILESET.INC
;
; Include File.
;
; Info:
;   Section              : rory face tiles
;   Bank                 : 0
;   Form                 : All tiles as one unit.
;   Format               : Gameboy 4 color.
;   Compression          : None.
;   Counter              : None.
;   Tile size            : 8 x 8
;   Tiles                : 0 to 69
;
;   Palette colors       : None.
;   SGB Palette          : None.
;   CGB Palette          : None.
;
;   Convert to metatiles : No.
;
; This file was generated by GBTD v2.2


; Bank of tiles.
rory_face_bl_tilesetBank EQU 0

; Start of tile array.
 GLOBAL rory_face_bl_tileset

; End of RORY_FACE_BLINK_TILESET.INC
